## CMakeLists.txt
```
#
# Copyright (c) 2025 Nordic Semiconductor
#
# SPDX-License-Identifier: LicenseRef-Nordic-5-Clause
#
cmake_minimum_required(VERSION 3.20.0)

find_package(Zephyr REQUIRED HINTS $ENV{ZEPHYR_BASE})
project(cpurad_boot)
include(${ZEPHYR_BASE}/samples/subsys/usb/common/common.cmake)

target_sources(app PRIVATE
  src/main.c
  src/arm_cleanup.c
  src/nrf_cleanup.c
)

include_directories(include)
```

## prj.conf
```kconfig
#
# Copyright (c) 2025 Nordic Semiconductor
#
# SPDX-License-Identifier: LicenseRef-Nordic-5-Clause
#

CONFIG_LOG=y
CONFIG_POWER_DOMAIN=n
# CONFIG_GPIO=n
CONFIG_CONSOLE=y
CONFIG_PRINTK=y
CONFIG_EARLY_CONSOLE=y

# Disable USB in bootloader - let application handle USB
CONFIG_USB_DEVICE_STACK_NEXT=y
CONFIG_USBD_HID_SUPPORT=y
CONFIG_USBD_LOG_LEVEL_WRN=y
CONFIG_USBD_HID_LOG_LEVEL_WRN=y
CONFIG_UDC_DRIVER_LOG_LEVEL_WRN=y
CONFIG_SAMPLE_USBD_PID=0x0007
CONFIG_UDC_DWC2_DMA=n
CONFIG_UDC_BUF_POOL_SIZE=8192

# VBUS detection - match application settings
CONFIG_UDC_DWC2_USBHS_VBUS_READY_TIMEOUT=10000

# Optimize for size to fit in larger partition
CONFIG_SIZE_OPTIMIZATIONS=y
```

## app.overlay
```dts
/*
 * Copyright (c) 2024 Nordic Semiconductor ASA
 *
 * SPDX-License-Identifier: LicenseRef-Nordic-5-Clause
 */

#include "../dts_common/nrf54h20_cpurad.dtsi"

/* Partition sizes are defined in memlayout.dtsi:
 * - cpurad_slot0_partition: 128KB bootloader @ 0x40000
 * - cpurad_app_partition: 1496KB application @ 0x60000
 */
```

## src/main.c
```c
/**
******************************************************************************
* Copyright (c) 2025 Nordic Semiconductor ASA
* Filename : main.c
* Date(DD-MM-YYYY)        Modification        Name
* ----------------        ------------        ----
*    19-09-2025             Created            JF
*******************************************************************************
*/

/* Includes ------------------------------------------------------------------*/
#include <zephyr/kernel.h>
#include <zephyr/arch/cpu.h>
#include <zephyr/arch/arm/arch.h>
#include <arm_cleanup.h>
#include <nrf_cleanup.h>
#include <zephyr/cache.h>
#include <zephyr/drivers/timer/system_timer.h>
#include <zephyr/logging/log.h>
#include <hal/nrf_gpio.h>
#include <zephyr/usb/usbd.h>
#include <zephyr/usb/class/usbd_hid.h>
#include <sample_usbd.h>
/* Macro----------------------------------------------------------------------*/
#define LOG_MODULE_NAME boot
LOG_MODULE_REGISTER(LOG_MODULE_NAME);


#define MRAM_NODE               DT_NODELABEL(mram1x)
#define APP_PARTITION_NODE      DT_NODELABEL(cpurad_app_partition)
#define TARGET_IMAGE_ADDRESS    (DT_REG_ADDR(MRAM_NODE) + DT_REG_ADDR(APP_PARTITION_NODE))

#define TEST_PIN_1 NRF_GPIO_PIN_MAP(9,0)/* MC : pin 9.0 */
#define TEST_PIN_2 NRF_GPIO_PIN_MAP(0,8)/* MC : pin 0.8 */



/* Private typedef -----------------------------------------------------------*/
typedef struct arm_vector_table_s 
{
	uint32_t msp;	       /* Initial stack pointer */
	uint32_t reset_vector; /* Reset handler address */
}arm_vector_table_t;

/* Private function prototypes------------------------------------------------*/
static void __attribute__((noreturn)) jump_to_image(uint32_t image_addr);

/* Global variables ----------------------------------------------------------*/

/* Private variables ---------------------------------------------------------*/

/* Macro ---------------------------------------------------------------------*/

/* Exported functions --------------------------------------------------------*/

#ifdef CONFIG_USB_DEVICE_STACK_NEXT
// static const struct gpio_dt_spec led0 = GPIO_DT_SPEC_GET(DT_ALIAS(led0), gpios);
static const uint8_t hid_report_desc[] = HID_MOUSE_REPORT_DESC(2);

#define MOUSE_BTN_LEFT		0
#define MOUSE_BTN_RIGHT		1

enum mouse_report_idx {
	MOUSE_BTN_REPORT_IDX = 0,
	MOUSE_X_REPORT_IDX = 1,
	MOUSE_Y_REPORT_IDX = 2,
	MOUSE_WHEEL_REPORT_IDX = 3,
	MOUSE_REPORT_COUNT = 4,
};

// K_MSGQ_DEFINE(mouse_msgq, MOUSE_REPORT_COUNT, 2, 1);
static bool mouse_ready;
struct usbd_context *sample_usbd;
const struct device *hid_dev;
// static void input_cb(struct input_event *evt, void *user_data)
// {
// 	static uint8_t tmp[MOUSE_REPORT_COUNT];

// 	ARG_UNUSED(user_data);

// 	switch (evt->code) {
// 	case INPUT_KEY_0:
// 		WRITE_BIT(tmp[MOUSE_BTN_REPORT_IDX], MOUSE_BTN_LEFT, evt->value);
// 		break;
// 	case INPUT_KEY_1:
// 		WRITE_BIT(tmp[MOUSE_BTN_REPORT_IDX], MOUSE_BTN_RIGHT, evt->value);
// 		break;
// 	case INPUT_KEY_2:
// 		if (evt->value) {
// 			tmp[MOUSE_X_REPORT_IDX] += 10U;
// 		}

// 		break;
// 	case INPUT_KEY_3:
// 		if (evt->value) {
// 			tmp[MOUSE_Y_REPORT_IDX] += 10U;
// 		}

// 		break;
// 	default:
// 		printk("Unrecognized input code %u value %d\n",
// 			evt->code, evt->value);
// 		return;
// 	}

// 	if (k_msgq_put(&mouse_msgq, tmp, K_NO_WAIT) != 0) {
// 		printk("Failed to put new input event\n");
// 	}

// 	tmp[MOUSE_X_REPORT_IDX] = 0U;
// 	tmp[MOUSE_Y_REPORT_IDX] = 0U;

// }

// INPUT_CALLBACK_DEFINE(NULL, input_cb, NULL);

static void mouse_iface_ready(const struct device *dev, const bool ready)
{
	printk("HID device %s interface is %s\n",
		dev->name, ready ? "ready" : "not ready");
	mouse_ready = ready;
}

static int mouse_get_report(const struct device *dev,
			 const uint8_t type, const uint8_t id, const uint16_t len,
			 uint8_t *const buf)
{
	printk("Get Report not implemented, Type %u ID %u\n", type, id);

	return 0;
}

struct hid_device_ops mouse_ops = {
	.iface_ready = mouse_iface_ready,
	.get_report = mouse_get_report,
};

int hsusb_init(void)
{

	int ret;

	// if (!gpio_is_ready_dt(&led0)) {
	// 	printk("LED device %s is not ready\n", led0.port->name);
	// 	return 0;
	// }

	// ret = gpio_pin_configure_dt(&led0, GPIO_OUTPUT);
	// if (ret != 0) {
	// 	printk("Failed to configure the LED pin, error: %d\n", ret);
	// 	return 0;
	// }

	hid_dev = DEVICE_DT_GET_ONE(zephyr_hid_device);
	if (!device_is_ready(hid_dev)) {
		printk("HID Device is not ready\n");
		return -EIO;
	}

	ret = hid_device_register(hid_dev,
				  hid_report_desc, sizeof(hid_report_desc),
				  &mouse_ops);
	if (ret != 0) {
		printk("Failed to register HID Device, %d\n", ret);
		return ret;
	}

	sample_usbd = sample_usbd_init_device(NULL);
	if (sample_usbd == NULL) {
		printk("Failed to initialize USB device\n");
		return -ENODEV;
	}

	ret = usbd_enable(sample_usbd);
	if (ret != 0) {
		printk("Failed to enable device support\n");
		return ret;
	}

	printk("USB device support enabled\n");

	return 0;
}
#endif

int main(void)
{
    LOG_PRINTK("****************************************\n");
    LOG_PRINTK("rad boot started\r\n");
    LOG_PRINTK("****************************************\n");
    nrf_gpio_cfg_output(TEST_PIN_1);
    nrf_gpio_pin_set(TEST_PIN_1); /* MC : set pin high to indicate bootloader is running */
    
    /* Configure P0.08 as input and check its level */
    nrf_gpio_cfg_input(TEST_PIN_2, NRF_GPIO_PIN_NOPULL);
    uint32_t pin_level = nrf_gpio_pin_read(TEST_PIN_2);
    if (pin_level) {
        LOG_PRINTK("P0.08 is HIGH\n");
    } else {
        LOG_PRINTK("P0.08 is LOW\n");
    }
    
    //customer code put here
#ifdef CONFIG_USB_DEVICE_STACK_NEXT
    hsusb_init();
    k_msleep(5000);
#endif
    //end of customer code

    jump_to_image(TARGET_IMAGE_ADDRESS);

    return 0;
}

/* Overrride functions -------------------------------------------------------*/

/* Private Functions ---------------------------------------------------------*/

/**
 * @brief Jump to another image at specified address
 *
 * This function performs a clean jump to another firmware image by:
 * 1. Disabling all interrupts
 * 2. Clearing NVIC pending interrupts
 * 3. Setting the vector table offset register (VTOR)
 * 4. Loading the new stack pointer and reset vector
 * 5. Jumping to the new image
 *
 * @param image_addr Address of the target image
 */
static void __attribute__((noreturn)) jump_to_image(uint32_t image_addr)
{
	arm_vector_table_t *vt = (arm_vector_table_t *)image_addr;

	LOG_PRINTK("Jumping to image at address 0x%08x\n", image_addr);
	LOG_PRINTK("Stack pointer: 0x%08x\n", vt->msp);
	LOG_PRINTK("Reset vector: 0x%08x\n", vt->reset_vector);

#ifdef CONFIG_USB_DEVICE_STACK_NEXT
	/* Properly shutdown USB before jumping */
	if (sample_usbd != NULL) {
		LOG_PRINTK("Shutting down USB\n");
		usbd_disable(sample_usbd);
		usbd_shutdown(sample_usbd);
		k_msleep(1000); /* Wait for USB to fully shutdown */
	}
#endif
    
    nrf_cleanup_peripheral();
    cleanup_arm_nvic(); /* cleanup NVIC registers */
    
    /* Additional delay for VBUS detection service to stabilize */
    k_msleep(500);
    
    LOG_PRINTK("GPIO and peripheral cleanup completed\n");

    /* Flush and disable instruction/data caches before chain-loading the application */
    (void)sys_cache_instr_flush_all();
    (void)sys_cache_data_flush_all();
    sys_cache_instr_disable();
    sys_cache_data_disable();

	z_arm_clear_arm_mpu_config();

#if defined(CONFIG_BUILTIN_STACK_GUARD) && defined(CONFIG_CPU_CORTEX_M_HAS_SPLIM)
	/* Reset stack limit registers */
	__set_PSPLIM(0);
	__set_MSPLIM(0);
#endif

	__set_MSP(vt->msp);
    __set_CONTROL(0x00); /* application will configures core on its own */
	__ISB();

	/* Jump to the new image reset vector */
	((void (*)(void))vt->reset_vector)();

	/* Should never reach here */
	CODE_UNREACHABLE;
}

/* Macro ---------------------------------------------------------------------*/
```

## src/nrf_cleanup.c
```c
/*
 * Copyright (c) 2020 Nordic Semiconductor ASA
 *
 * SPDX-License-Identifier: LicenseRef-Nordic-5-Clause
 */

#if defined(CONFIG_NRFX_CLOCK)
#include <hal/nrf_clock.h>
#endif
#include <hal/nrf_uarte.h>
#include <haly/nrfy_uarte.h>
#include <haly/nrfy_gpio.h>
#if defined(NRF_RTC0) || defined(NRF_RTC1) || defined(NRF_RTC2)
    #include <hal/nrf_rtc.h>
#endif
#if defined(CONFIG_NRF_GRTC_TIMER)
    #include <nrfx_grtc.h>
#endif
#if defined(NRF_PPI)
    #include <hal/nrf_ppi.h>
#endif
#if defined(NRF_DPPIC)
    #include <hal/nrf_dppi.h>
#endif
#if defined(CONFIG_USB_DEVICE_STACK_NEXT)
    #include <zephyr/drivers/usb/udc.h>
#endif
#if defined(NRF_GPIO)
    #include <hal/nrf_gpio.h>
#endif

#include <string.h>

#if USE_PARTITION_MANAGER
#include <pm_config.h>
#endif

#if defined(NRF_UARTE0) || defined(NRF_UARTE1) || defined(NRF_UARTE20) ||   \
    defined(NRF_UARTE30)
#define NRF_UARTE_CLEANUP
#endif

#define NRF_UARTE_SUBSCRIBE_CONF_OFFS offsetof(NRF_UARTE_Type, SUBSCRIBE_STARTRX)
#define NRF_UARTE_SUBSCRIBE_CONF_SIZE (offsetof(NRF_UARTE_Type, EVENTS_CTS) -\
                                       NRF_UARTE_SUBSCRIBE_CONF_OFFS)

#define NRF_UARTE_PUBLISH_CONF_OFFS offsetof(NRF_UARTE_Type, PUBLISH_CTS)
#define NRF_UARTE_PUBLISH_CONF_SIZE (offsetof(NRF_UARTE_Type, SHORTS) -\
                                     NRF_UARTE_PUBLISH_CONF_OFFS)

#if defined(NRF_RTC0) || defined(NRF_RTC1) || defined(NRF_RTC2)
static inline void nrf_cleanup_rtc(NRF_RTC_Type * rtc_reg)
{
    nrf_rtc_task_trigger(rtc_reg, NRF_RTC_TASK_STOP);
    nrf_rtc_event_disable(rtc_reg, 0xFFFFFFFF);
    nrf_rtc_int_disable(rtc_reg, 0xFFFFFFFF);
}
#endif

#if defined(CONFIG_NRF_GRTC_TIMER)
static inline void nrf_cleanup_grtc(void)
{
    nrfx_grtc_uninit();
}
#endif

#if defined(NRF_UARTE_CLEANUP)
static NRF_UARTE_Type *nrf_uarte_to_clean[] = {
#if defined(NRF_UARTE0)
    NRF_UARTE0,
#endif
#if defined(NRF_UARTE1)
    NRF_UARTE1,
#endif
#if defined(NRF_UARTE20)
    NRF_UARTE20,
#endif
#if defined(NRF_UARTE30)
    NRF_UARTE30,
#endif
#if defined(NRF_UARTE136)
    NRF_UARTE136,
#endif
};
#endif

#if defined(CONFIG_NRFX_CLOCK)
static void nrf_cleanup_clock(void)
{
    nrf_clock_int_disable(NRF_CLOCK, 0xFFFFFFFF);
}
#endif

#if defined(CONFIG_USB_DEVICE_STACK_NEXT)
static void nrf_cleanup_usb(void)
{
    /* Reset USB controller registers to default state */
    volatile uint32_t *usb_base = (volatile uint32_t *)0x5F086000; /* USBHS base address */
    
    /* Disconnect USB device first */
    usb_base[0x800 / 4] |= (1 << 1); /* DCTL - Soft Disconnect */
    
    /* Small delay for disconnect to take effect */
    for (volatile int i = 0; i < 10000; i++) { }
    
    /* Disable USB interrupts */
    usb_base[0x014 / 4] = 0; /* GINTMSK - disable all interrupts */
    usb_base[0x818 / 4] = 0; /* DIEPMSK - disable IN endpoint interrupts */
    usb_base[0x81C / 4] = 0; /* DOEPMSK - disable OUT endpoint interrupts */
    usb_base[0x81C / 4] = 0; /* DAINTMSK - disable all endpoint interrupts */
    
    /* Soft reset USB core */
    usb_base[0x010 / 4] |= (1 << 0); /* GRSTCTL - Core Soft Reset */
    
    /* Wait for reset to complete */
    for (volatile int timeout = 0; timeout < 100000; timeout++) {
        if (!(usb_base[0x010 / 4] & (1 << 0))) {
            break;
        }
    }
#if defined(NRF_GPIO)
static void nrf_cleanup_gpio(void)
{
    /* For nRF54H20, GPIO ports are at specific addresses */
    /* Check device tree or HAL for actual port definitions */
    volatile uint32_t *gpio0_base = (volatile uint32_t *)0x50938000;  /* GPIO0 */
    volatile uint32_t *gpio1_base = (volatile uint32_t *)0x50939000;  /* GPIO1 */
    volatile uint32_t *gpio2_base = (volatile uint32_t *)0x5093A000;  /* GPIO2 */
    volatile uint32_t *gpio9_base = (volatile uint32_t *)0x50941000;  /* GPIO9 */
    
    volatile uint32_t **gpio_bases[] = {gpio0_base, gpio1_base, gpio2_base, gpio9_base};
    
    for (int port_idx = 0; port_idx < 4; port_idx++) {
        volatile uint32_t *port_base = gpio_bases[port_idx];
        
        /* Reset all PIN_CNF registers (offset 0x200 for PIN_CNF[0]) */
        for (uint32_t pin = 0; pin < 32; pin++) {
            /* PIN_CNF[n] is at offset 0x200 + n*4 */
            port_base[(0x200 + pin * 4) / 4] = 
                (0 << 0) |  /* DIR: Input */
                (1 << 1) |  /* INPUT: Disconnect */
                (0 << 2) |  /* PULL: Disabled */
                (0 << 8) |  /* DRIVE: S0S1 */
                (0 << 16);  /* SENSE: Disabled */
        }
        
        /* Clear LATCH register (offset 0x51C) */
        port_base[0x51C / 4] = 0xFFFFFFFF;
    }
}
#endif

}
#endif

void nrf_cleanup_peripheral(void)
{
#if defined(NRF_RTC0)
    nrf_cleanup_rtc(NRF_RTC0);
#endif
#if defined(NRF_RTC1)
    nrf_cleanup_rtc(NRF_RTC1);
#endif
#if defined(NRF_RTC2)
    nrf_cleanup_rtc(NRF_RTC2);
#endif

#if defined(CONFIG_NRF_GRTC_TIMER)
    nrf_cleanup_grtc();
#endif

#if defined(NRF_UARTE_CLEANUP)
    for (int i = 0; i < sizeof(nrf_uarte_to_clean) / sizeof(nrf_uarte_to_clean[0]); ++i) {
        NRF_UARTE_Type *current = nrf_uarte_to_clean[i];

        nrfy_uarte_int_disable(current, 0xFFFFFFFF);
        nrfy_uarte_int_uninit(current);
        nrfy_uarte_task_trigger(current, NRF_UARTE_TASK_STOPRX);

        nrfy_uarte_event_clear(current, NRF_UARTE_EVENT_RXSTARTED);
        nrfy_uarte_event_clear(current, NRF_UARTE_EVENT_ENDRX);
        nrfy_uarte_event_clear(current, NRF_UARTE_EVENT_RXTO);
        nrfy_uarte_disable(current);

#ifndef CONFIG_SOC_SERIES_NRF54LX
        /* Disconnect pins UARTE pins
         * causes issues on nRF54l SoCs,
         * could be enabled once fix to NCSDK-33039 will be implemented.
         */

        uint32_t pin[4];

        pin[0] = nrfy_uarte_tx_pin_get(current);
        pin[NRF_GPIO)
    nrf_cleanup_gpio();
#endif

#if defined(1] = nrfy_uarte_rx_pin_get(current);
        pin[2] = nrfy_uarte_rts_pin_get(current);
        pin[3] = nrfy_uarte_cts_pin_get(current);

        nrfy_uarte_pins_disconnect(current);

        for (int j = 0; j < 4; j++) {
            if (pin[j] != NRF_UARTE_PSEL_DISCONNECTED) {
                nrfy_gpio_cfg_default(pin[j]);
            }
        }
#endif

#if defined(NRF_DPPIC)
        /* Clear all SUBSCRIBE configurations. */
        memset((uint8_t *)current + NRF_UARTE_SUBSCRIBE_CONF_OFFS, 0,
               NRF_UARTE_SUBSCRIBE_CONF_SIZE);
        /* Clear all PUBLISH configurations. */
        memset((uint8_t *)current + NRF_UARTE_PUBLISH_CONF_OFFS, 0,
               NRF_UARTE_PUBLISH_CONF_SIZE);
#endif
    }
#endif

#if defined(NRF_PPI)
    nrf_ppi_channels_disable_all(NRF_PPI);
#endif
#if defined(NRF_DPPIC)
    nrf_dppi_channels_disable_all(NRF_DPPIC);
#endif

#if defined(CONFIG_NRFX_CLOCK)
    nrf_cleanup_clock();
#endif

#if defined(CONFIG_USB_DEVICE_STACK_NEXT)
    nrf_cleanup_usb();
#endif
}

#if USE_PARTITION_MANAGER \
	&& defined(CONFIG_ARM_TRUSTZONE_M) \
	&& defined(PM_SRAM_NONSECURE_NAME)
void nrf_cleanup_ns_ram(void)
{
	memset((void *) PM_SRAM_NONSECURE_ADDRESS, 0, PM_SRAM_NONSECURE_SIZE);
}
#endif
```
